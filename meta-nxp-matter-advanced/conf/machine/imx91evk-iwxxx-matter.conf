## meta-nxp-matter-advanced/conf/machine/imx91evk-iwxxx-matter.conf
```bitbake
#@TYPE: Machine
#@NAME: A consolidated IW612 MATTER machine for i.MX 91 EVK
#@SOC: i.MX91
#@MAINTAINER: Junmeng Li <junmeng.li_1@nxp.com>

MACHINEOVERRIDES =. "imx91-11x11-lpddr4-evk:"
require conf/machine/imx91-11x11-lpddr4-evk.conf

DELTA_KERNEL_DEFCONFIG="${UNPACKDIR}/kernel-config/*"
# Include device trees for other boards for internal test
KERNEL_DEVICETREE += " \
        freescale/imx91-11x11-evk-ffu_gpio_irq.dtb \
"
DTS_FILE="${BSPDIR}/sources/meta-nxp-connectivity/meta-nxp-otbr/recipes-kernel/linux/files/dts/imx91-11x11-evk-ffu_gpio_irq.dts"

UBOOT_DELTA_CONFIG="${UNPACKDIR}/uboot-config/*"

IMAGE_INSTALL:append = " packagegroup-nxp-matter-baseline packagegroup-nxp-openthread packagegroup-nxp-otbr packagegroup-nxp-zigbee-rcp docker-moby "
```
